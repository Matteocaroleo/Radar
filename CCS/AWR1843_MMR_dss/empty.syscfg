/**
 * These arguments were used when this file was generated. They will be automatically applied on subsequent loads
 * via the GUI or CLI. Run CLI with '--help' for additional information on how to override these arguments.
 * @cliArgs --device "AWR18XX" --part "Default" --package "Default"
 * @v2CliArgs --device "AWR1843" --package "FCCSP (ABL)"
 * @versions {"tool":"1.23.0+4000"}
 */
